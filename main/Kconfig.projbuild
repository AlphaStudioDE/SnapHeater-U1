## main/Kconfig.projbuild
```kconfig
menu "SnapHeater U1"

config SHU1_WIFI_SSID
    string "Wi-Fi SSID"
    default "YOUR_WIFI"

config SHU1_WIFI_PASSWORD
    string "Wi-Fi password"
    default "YOUR_PASSWORD"

config SHU1_MOONRAKER_HOST
    string "Snapmaker U1 / Moonraker host or IP"
    default "192.168.1.100"

config SHU1_MOONRAKER_PORT
    int "Moonraker port"
    default 7125

menu "BLE / Android control"

config SHU1_ENABLE_BLE
    bool "Enable BLE GATT control service"
    default y
    help
        Enables local Android control through Bluetooth Low Energy.
        BLE remains a local channel; Moonraker synchronization still uses Wi-Fi.

config SHU1_BLE_DEVICE_NAME
    string "BLE advertised device name"
    default "SnapHeater U1"

config SHU1_BLE_REQUIRE_PIN_FOR_CONTROL
    bool "Require PIN unlock before accepting BLE control writes"
    default y
    help
        When enabled, the Android app must first write {"unlock":"PIN"}.
        Status/diagnostics reads are still allowed without unlock.

config SHU1_BLE_CONTROL_PIN
    string "BLE local control PIN"
    default "123456"
    help
        Development PIN. Change before real use. This is an application-level lock,
        not a replacement for BLE pairing/bonding in a production app.

config SHU1_BLE_NOTIFY_PERIOD_MS
    int "BLE status notification period in ms"
    default 2000
    range 500 10000

config SHU1_BLE_MAX_WRITE_BYTES
    int "Maximum BLE control write payload bytes"
    default 512
    range 64 1024

config SHU1_BLE_MAX_READ_BYTES
    int "Maximum BLE read payload bytes"
    default 4096
    range 256 4096

endmenu

menu "Smart heating / cooldown policy"

config SHU1_DEFAULT_FAN_POSTRUN_MIN
    int "Default fan post-run time after heater off, minutes"
    default 1
    range 0 60
    help
        Used as the factory default for the user setting fan_postrun_min.

config SHU1_DEFAULT_TEMPERING_ENABLED
    bool "Enable print-finish tempering by default (Android/user option)"
    default n

config SHU1_DEFAULT_TEMPERING_END_TEMP_C
    int "Default tempering end temperature after print finish (0 = ramp to heater off)"
    default 0
    range 0 60
    help
        0 means ramp the virtual chamber target down to heater-off by the selected duration.
        Higher values keep a low final target until the ramp completes, then switch heating off.

config SHU1_DEFAULT_TEMPERING_DURATION_MIN
    int "Default tempering ramp duration after print finish, minutes"
    default 30
    range 0 240

endmenu

menu "Panda Breath hardware pins"

comment "Stock map is compile-checked; arbitrary GPIO remapping is forbidden"

config SHU1_HEATER_GPIO
    int "Heater/PTC output GPIO"
    default 18
    help
        Panda Breath MGR GJ-5-L SSR control (RLY_MOSFET), inferred by DragonBreath.
        DragonBreath requires continuity confirmation before flashing this pin.
        Mapping the pin does not enable heater output; the separate build and
        runtime safety locks remain authoritative.

config SHU1_FAN_GPIO
    int "Fan/filter output GPIO"
    default 3
    help
        Panda Breath MOC3021/BT136 held-gate output, validated by DragonBreath.

config SHU1_ZERO_CROSS_GPIO
    int "Zero-cross detector GPIO (-1 disables)"
    default 7
    help
        Panda Breath MB6S/TLP785 zero-cross input, validated by DragonBreath.

config SHU1_RREF_STRAP_GPIO
    int "NTC reference-resistor strap GPIO"
    default 19
    range 0 21
    help
        Panda Breath board-revision strap. Firm LOW selects 82 kOhm and firm
        HIGH selects 33 kOhm. A floating strap fails safe to 33 kOhm.

config SHU1_BUTTON_GPIO
    int "Legacy generic physical button GPIO (-1 disables)"
    default -1
    help
        Legacy status/API field only. Keep disabled by default because GPIO7
        belongs to the zero-cross detector path.

config SHU1_STATUS_LED_GPIO
    int "Status LED GPIO (-1 disables)"
    default -1
    help
        Must remain -1 on stock Panda Breath. Use the mapped panel LEDs;
        a generic LED writer could otherwise bypass the SSR/TRIAC driver.

config SHU1_CHAMBER_ADC_CH
    int "ADC1 channel for chamber/warehouse NTC"
    default 0
    help
        ADC1_CH0 is GPIO0 on ESP32-C3. Accepted chamber/warehouse NTC input.

config SHU1_PTC_ADC_CH
    int "ADC1 channel for PTC NTC"
    default 1
    help
        ADC1_CH1 is GPIO1 on ESP32-C3. Accepted PTC element NTC input.

endmenu



menu "Physical buttons and indicator LEDs"

config SHU1_ENABLE_PHYSICAL_CONTROLS
    bool "Enable Panda Breath-style physical controls"
    default n
    help
        Adds the DragonBreath-confirmed Power/Auto/On/Dry panel. GPIO9, GPIO8
        and GPIO2 are boot strapping pins; a button held during boot is ignored
        until released. The complete panel remains build-disabled by default.

config SHU1_BUTTON_ACTIVE_LOW
    bool "Physical buttons are active low"
    default y
    help
        Most small button inputs are pulled up and close to GND.

config SHU1_LED_ACTIVE_HIGH
    bool "Indicator LEDs are active high"
    default y
    help
        Set to n only if a later board revision uses active-low LED drivers.

config SHU1_BUTTON_AUTO_GPIO
    int "AUTO button GPIO (-1 disables)"
    default 8

config SHU1_BUTTON_ON_GPIO
    int "ON / Manual button GPIO (-1 disables)"
    default 10

config SHU1_BUTTON_POWER_GPIO
    int "Power button GPIO (-1 disables)"
    default 9

config SHU1_BUTTON_DRY_GPIO
    int "Dry button GPIO (-1 disables)"
    default 2

config SHU1_LED_AUTO_GPIO
    int "AUTO button/backlight LED GPIO (-1 disables)"
    default 6

config SHU1_LED_ON_GPIO
    int "ON/Manual button/backlight LED GPIO (-1 disables)"
    default 5

config SHU1_LED_DRY_GPIO
    int "Dry mode LED GPIO (-1 disables)"
    default 4

config SHU1_ENABLE_POWER_LED
    bool "Drive Power LED on GPIO21 (disables UART0 TX use)"
    default n
    help
        GPIO21 is shared with UART0 TX. Enable only in a release build where
        losing the serial console is intentional.

config SHU1_LED_POWER_GPIO
    int "Power LED GPIO"
    default 21

config SHU1_PHYSICAL_DEBOUNCE_MS
    int "Button debounce time in ms"
    default 20
    range 10 200

config SHU1_PHYSICAL_LONG_PRESS_MS
    int "Long press threshold in ms"
    default 2000
    range 500 8000

config SHU1_PHYSICAL_TASK_PERIOD_MS
    int "Physical controls polling period in ms"
    default 10
    range 10 500

config SHU1_PHYSICAL_TASK_STACK_BYTES
    int "Physical controls task stack size in bytes"
    default 8192
    range 4096 16384
    help
        Physical controls read the shared settings/runtime state and need more stack
        than the minimum ESP32-C3 task size. Increase this if additional local UI
        behavior is added.

endmenu

menu "Output safety locks"

config SHU1_SAFETY_TASK_STACK_BYTES
    int "Safety/control task stack size in bytes"
    default 16384
    range 8192 32768
    help
        The safety loop evaluates settings, runtime and printer state in one pass.
        ESP32-C3 bring-up builds need a larger stack than the FreeRTOS minimum
        because these state structures are intentionally comprehensive.

config SHU1_ENABLE_HEATER_OUTPUT
    bool "Enable normal physical heater output"
    default n
    help
        Enables normal physical heater output. Keep disabled until the
        DragonBreath-derived Panda Breath hardware layer, sensors, zero-cross,
        fan airflow and independent cutoff have been validated.

config SHU1_HEATER_ACTIVE_HIGH
    bool "Heater output is active high"
    default y
    help
        Accepted Panda Breath polarity: HIGH = ON.

config SHU1_FAN_ACTIVE_HIGH
    bool "Fan output is active high"
    default y
    help
        Panda Breath GPIO3 held-gate polarity validated by DragonBreath:
        HIGH = fan ON at full speed, LOW = OFF.
        Setting this to n with a mapped fan pin is a compile-time error.

config SHU1_ENABLE_FAN_TRIAC_CONTROL
    bool "Use Panda Breath zero-cross held-gate fan control"
    default n
    help
        Stock-compatible binary ON/OFF control. GPIO3 is held HIGH for full-speed
        ON and LOW for OFF; ON transitions are applied at a filtered GPIO7
        zero-cross. The gate is never PWM'd or phase-angle chopped.

config SHU1_ENABLE_GPIO_PROBE
    bool "Enable diagnostic fan pulse API"
    default n
    help
        Enables short manual fan commands on /api/probe. Heater probe commands
        are always rejected; heating is allowed only through normal PID control
        and all safety governors.

config SHU1_MAX_FAN_PROBE_MS
    int "Maximum fan probe pulse length in ms"
    default 3000
    range 100 10000

endmenu

menu "Temperature policy"

config SHU1_TARGET_TEMP_C
    int "Default chamber target temperature"
    default 50
    range 0 70

config SHU1_MAX_TARGET_TEMP_C
    int "Maximum user chamber target temperature"
    default 70
    range 30 70
    help
        DragonBreath-compatible user target ceiling. Fixed safety cutoffs remain
        independent and cannot be raised through this setting.

config SHU1_PTC_CUTOFF_C
    int "PTC soft foldback cutoff temperature"
    default 0
    range 0 104
    help
        0 selects DragonBreath's board-specific default (33k: 99/96 C,
        82k: 102/99 C). An advanced positive override is constrained by
        application code to 90..104 C. The fixed 105 C PTC and 85 C chamber
        hard cutoffs cannot be raised by configuration.

config SHU1_FILTER_TRIGGER_BED_C
    int "Default bed temp threshold for filter/fan in auto mode"
    default 30
    range 0 120

config SHU1_HEATER_TRIGGER_BED_C
    int "Default bed temp threshold for heater permission in auto mode"
    default 80
    range 30 120
    help
        Based on multi-version observations: filtertemp around 30 C and hotbedtemp around 80 C.
        Tune for Snapmaker U1 after real testing.

endmenu

endmenu
```
